;AP WDT disable
d.s asd:0x10211000 %le %long 0x22000000

